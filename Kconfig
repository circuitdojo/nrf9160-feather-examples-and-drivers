## Kconfig
```kconfig
#
# Copyright (c) 2020 Circuit Dojo
#
# SPDX-License-Identifier: Apache-2.0
#

menu "nRF9160 Feather"

rsource "drivers/Kconfig"

endmenu
```

## boards/arm/cd_test_board/Kconfig.board
```kconfig
# Circuit Dojo Test Board

# Copyright (c) 2016 Nordic Semiconductor ASA
# SPDX-License-Identifier: Apache-2.0

config BOARD_CD_TEST_BOARD
	bool "Circuit Dojo nRF52 Test Board"
	depends on SOC_NRF52840_QIAA
```

## boards/arm/cd_test_board/Kconfig.defconfig
```kconfig
# Circuit Dojo Test Board

# Copyright (c) 2016 Nordic Semiconductor ASA
# SPDX-License-Identifier: Apache-2.0

if BOARD_CD_TEST_BOARD

config BOARD
	default "cd_test_board"

if USB

config USB_NRFX
	default y

config USB_DEVICE_STACK
	default y

endif # USB

config BT_CTLR
	default BT

endif # BOARD_CD_TEST_BOARD
```

## boards/circuitdojo/feather_nrf9151/Kconfig
```kconfig
if !MCUBOOT
config CIRCUITDOJO_FEATHER_NRF9151_PMIC_STARTUP
	bool "Allows for executing startup code for PMIC."
	default y
endif
```

## boards/circuitdojo/feather_nrf9151/Kconfig.circuitdojo_feather_nrf9151
```kconfig
# Copyright (c) 2020-2026 Circuit Dojo LLC
# SPDX-License-Identifier: Apache-2.0

config BOARD_CIRCUITDOJO_FEATHER_NRF9151
	select SOC_NRF9151_LACA
```

## boards/circuitdojo/feather_nrf9151/board.yml
```yaml
board:
  name: circuitdojo_feather_nrf9151
  full_name: Circuit Dojo Feather nRF9151
  vendor: circuitdojo
  socs:
    - name: nrf9151
      variants:
        - name: ns
  revision:
    format: number
    default: "3"
    revisions:
      - name: "1"
      - name: "2"
      - name: "3"
```

## boards/circuitdojo/feather_nrf9151/circuitdojo_feather_nrf9151_ns_defconfig
```kconfig
# SPDX-License-Identifier: Apache-2.0

# Enable MPU
CONFIG_ARM_MPU=y

# Enable TrustZone-M
CONFIG_ARM_TRUSTZONE_M=y

# This Board implies building Non-Secure firmware
CONFIG_TRUSTED_EXECUTION_NONSECURE=y

# Hardware stack protection
CONFIG_HW_STACK_PROTECTION=y

# Enable GPIO
CONFIG_GPIO=y

# Enable uart driver
CONFIG_SERIAL=y

# Enable console
CONFIG_CONSOLE=y
CONFIG_UART_CONSOLE=y

# Enable pincontrol
CONFIG_PINCTRL=y

# Enable I2C
CONFIG_I2C=y

# Enable MFD
CONFIG_MFD_NPM1300=y
```

## boards/circuitdojo/feather_nrf9161/Kconfig.sysbuild
```kconfig
# Copyright (c) 2026 Circuit Dojo LLC
# SPDX-License-Identifier: Apache-2.0

config PARTITION_MANAGER
	default n
```

## drivers/Kconfig
```kconfig
#
# Copyright (c) 2020 Circuit Dojo LLC
#
# SPDX-License-Identifier: Apache-2.0
#

comment "Device Drivers"

rsource "rtc/Kconfig"
rsource "battery/Kconfig"
```

## drivers/battery/Kconfig
```kconfig
#
# Copyright (c) 2021 Circuit Dojo LLC
#

menuconfig BATTERY_MEASUREMENT
	bool "Voltage divider battery measurement"
	depends on GPIO
    depends on ADC
	help
	  Enable battery measurement "sensor"
```

## drivers/rtc/Kconfig
```kconfig
#
# Copyright (c) 2020 Circuit Dojo LLC
#
# SPDX-License-Identifier: Apache-2.0
#

comment "RTC Drivers"

rsource "pcf85063a/Kconfig"
```

## drivers/rtc/pcf85063a/Kconfig
```kconfig
# PCF85063A Nano Power Real time Clock configuration options

#
# Copyright (c) 2020 Circuit Dojo LLC
#
# SPDX-License-Identifier: Apache-2.0
#

menuconfig PCF85063A
	bool "PCF85063A Real Time Clock"
	depends on I2C
	help
	  Enable SPI/I2C-based driver for PCF85063A based RTC
```

## lib/codec/Kconfig
```kconfig
mainmenu "Example JSON Codec"

config EXAMPLE_JSON_CODEC_ENABLE
	bool "Enable the JSON codec"
	select JSON_LIBRARY
```

## samples/https/src/cloud/Kconfig
```kconfig
mainmenu "Application Cloud Configuration"

config CLOUD_TLS_SEC_TAG
    int "TLS Sec Tag"
    default 42

config CLOUD_HOSTNAME
	string "Base URL"
	default "www.circuitdojo.com"

config CLOUD_PORT
    int "Port"
    default 443

config CLOUD_PUBLISH_PATH
    string "Publish Path"
    default "/some/path"
```

## samples/tracker/src/ext_sensors/Kconfig
```kconfig
#
# Copyright (c) 2021 Nordic Semiconductor
#
# SPDX-License-Identifier: LicenseRef-Nordic-5-Clause
#

menuconfig EXTERNAL_SENSORS
	bool "External sensors"

if EXTERNAL_SENSORS

if BOARD_THINGY91_NRF9160NS

config EXTERNAL_SENSOR_ENVIRONMENTAL
	bool "Enable environmental sensor if Thingy91"
	default y

endif

module = EXTERNAL_SENSORS
module-str = External sensors
source "subsys/logging/Kconfig.template.log_config"

endif # EXTERNAL_SENSORS
```

## samples/tracker/src/gps/Kconfig
```kconfig
#
# Copyright (c) 2018 Nordic Semiconductor ASA
#
# SPDX-License-Identifier: LicenseRef-Nordic-5-Clause
#

mainmenu "Application GPS Configuration"

config GNSS_SAMPLE_PERIODIC_INTERVAL
	int "Fix interval for periodic fixes"
	range 10 65535
	default 120
	help
	  Fix interval (in seconds) for periodic fixes.

config GNSS_SAMPLE_PERIODIC_TIMEOUT
	int "Fix timeout for periodic fixes"
	range 0 65535
	default 120
	help
	  Fix timeout (in seconds) for periodic fixes.
	  If set to zero, GNSS is allowed to run indefinitely until a valid PVT estimate is produced.
```

## samples/tracker/src/shell/Kconfig
```kconfig
menuconfig SHELL_AT_CMD
	bool "AT Shell"
	depends on NRF_MODEM_LIB
	depends on SHELL
	depends on !SHELL_WILDCARD
	help
	  Adds the AT command capability to shell. The shell command is called
	  "at" and will interpret arguments as AT commands, and print back the
	  response from the modem.


if SHELL_AT_CMD

config SHELL_AT_CMD_RESPONSE_MAX_LEN
	int "Maximum AT command response length"
	default 2700

endif # SHELL_AT_CMD
```

## samples/tracker/src/storage/Kconfig
```kconfig
#
# Copyright (c) 2021 Circuit Dojo LLC
#
# SPDX-License-Identifier: LicenseRef-Circuit-Dojo-5-Clause
#

mainmenu "App storage configuration"

config APP_STORAGE_WIPE
	bool "Option to clear the flash area before mounting"
	help
	  Use this to force an existing file system to be created.

config APP_STORAGE_INIT_PRIORITY
    int "Init priority for storage/settings config"
    default 80
```

## samples/tracker/src/version/Kconfig
```kconfig
menu "App Version"

config APP_VERSION
	string "Full version string provided by Git"
	default "1.0.0"

endmenu
```
