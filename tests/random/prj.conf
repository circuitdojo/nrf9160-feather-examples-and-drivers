## prj.conf
```kconfig
CONFIG_ZTEST=y

CONFIG_ENTROPY_GENERATOR=y
CONFIG_ENTROPY_DEVICE_RANDOM_GENERATOR=y
```

## boards/circuitdojo_feather_nrf9160_ns.conf
```kconfig
# Enable Zephyr application to be booted by MCUboot
CONFIG_BOOTLOADER_MCUBOOT=y
```

## src/main.c
```c
#include <string.h>

#include <zephyr/ztest.h>
#include <zephyr/random/random.h>

#include <zephyr/logging/log.h>
LOG_MODULE_REGISTER(random_tests);

#define TOP_NUMBER 10

ZTEST_SUITE(random_tests, NULL, NULL, NULL, NULL, NULL);

/**
 * @brief Test encoding of sensor data
 *
 * Tests the encoding of single and multiple sensor data packages
 *
 */
ZTEST(random_tests, test_random_number_between_1_and_x)
{

	uint32_t num = sys_rand32_get() % (TOP_NUMBER + 1);

	/* If we happen to get 0, move up to 1*/
	if (num == 0)
		num = 1;

	printk("Random: %i\n", num);
	zassert_between_inclusive(num, 1, TOP_NUMBER);
}
```
