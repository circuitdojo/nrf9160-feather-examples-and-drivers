## boards/circuitdojo/feather_nrf9151/Kconfig.sysbuild
```kconfig
# Copyright (c) 2026 Circuit Dojo LLC
# SPDX-License-Identifier: Apache-2.0

config FEATHER_NRF9151_DEBUG_ACCESS_OPEN
	bool "Keep debug access open across resets"
	default y
	help
	  Flash uicr_debug_access_open.hex with the build. It writes the
	  HwUnprotected value (0x50FA50FA) to UICR.APPROTECT and
	  UICR.SECUREAPPROTECT, so images built with
	  CONFIG_NRF_(SECURE_)APPROTECT_USE_UICR reopen the debug port on every
	  boot. Without it, the nRF91x1 locks the debug port after each pin or
	  power-on reset until the chip is erased.

	  The UICR words can only be written from the erased state, so this takes
	  effect on a full erase and flash. Disable for production.

	  The hex is its own sysbuild image (an NCS image flasher named
	  uicr_debug_access_open, listed in domains.yaml), so no application or
	  update hex ever touches UICR. With b0 or MCUboot it takes the
	  bootloader's board and configuration. `west flash` runs it after the
	  default image; Zephyr Tools flashes it with every other image in
	  merged_<board_target>.hex (MERGED_HEX_FILES).

config MERGED_HEX_FILES
	default y
	help
	  The UICR image (FEATHER_NRF9151_DEBUG_ACCESS_OPEN) is its own sysbuild
	  image, flashed separately from the application unless merged. Two
	  probe-rs sessions let the chip reset in between with no firmware that
	  opens the debug port, and the nRF91x1 locks it. Merge every image into
	  merged_<board_target>.hex so a single download writes them all.
```

## boards/circuitdojo/feather_nrf9160/Kconfig.circuitdojo_feather_nrf9160
```kconfig
# Circuit Dojo nRF9160 Feather configuration

# Copyright (c) 2018-2020 Nordic Semiconductor ASA
# Copyright (c) 2020-2026 Circuit Dojo LLC
# SPDX-License-Identifier: Apache-2.0

config BOARD_CIRCUITDOJO_FEATHER_NRF9160
	select SOC_NRF9160_SICA
```

## boards/circuitdojo/feather_nrf9160/board.yml
```yaml
board:
  name: circuitdojo_feather_nrf9160
  full_name: Circuit Dojo Feather nRF9160
  vendor: circuitdojo
  socs:
    - name: nrf9160
      variants:
        - name: "ns"
  revision:
    format: number
    default: "6"
    revisions:
      - name: "6"
```

## boards/circuitdojo/feather_nrf9161/Kconfig.circuitdojo_feather_nrf9161
```kconfig
# Copyright (c) 2020-2026 Circuit Dojo LLC
# SPDX-License-Identifier: Apache-2.0

config BOARD_CIRCUITDOJO_FEATHER_NRF9161
	select SOC_NRF9161_LACA
```

## boards/circuitdojo/feather_nrf9161/board.yml
```yaml
board:
  name: circuitdojo_feather_nrf9161
  full_name: Circuit Dojo Feather nRF9161
  vendor: circuitdojo
  socs:
    - name: nrf9161
      variants:
        - name: ns
  revision:
    format: number
    default: "1"
    revisions:
      - name: "1"
```

## boards/test/cd_test_board/board.yml
```yaml
board:
  name: cd_test_board
  full_name: CD Test Board
  vendor: circuitdojo
  socs:
    - name: nrf52840
```

## samples/serial_lte_modem/sample.yaml
```yaml
sample:
  name: Serial LTE Modem
tests:
  applications.serial_lte_modem:
    sysbuild: true
    build_only: true
    platform_allow:
      - circuitdojo_feather_nrf9151/nrf9151/ns
    integration_platforms:
      - circuitdojo_feather_nrf9151/nrf9151/ns
    tags:
      - ci_build
      - sysbuild
      - ci_applications_serial_lte_modem
```

## tests/codec/testcase.yaml
```yaml
tests:
  codec_tests.test_encoding_of_sensor_data:
    platform_allow: 
      - circuitdojo_feather_nrf9151/nrf9151/ns
      - native_sim
    tags: codec
```

## tests/example/testcase.yaml
```yaml
tests:
  example.framework_tests:
    platform_allow: 
      - circuitdojo_feather_nrf9151/nrf9151/ns
      - native_sim
      - qemu_cortex_m3
    tags: framework_tests
```

## tests/random/testcase.yaml
```yaml
tests:
  random_tests.random_number_between_1_and_x:
    platform_allow:
      - circuitdojo_feather_nrf9160/nrf9160/ns
      - circuitdojo_feather_nrf9151/nrf9151/ns
    tags: random
```
