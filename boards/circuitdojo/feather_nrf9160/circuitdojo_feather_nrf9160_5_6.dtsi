/*
 * Copyright (c) 2024-2026 Circuit Dojo LLC
 *
 * SPDX-License-Identifier: Apache-2.0
 */

/ {

	leds {
		compatible = "gpio-leds";
		blue_led: led_0 {
			gpios = <&gpio0 3 GPIO_ACTIVE_HIGH>;
			label = "Blue LED (D7)";
		};
	};

	/delete-node/ nrf-ps-en;
};