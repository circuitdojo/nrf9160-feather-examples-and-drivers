## CMakeLists.txt
```
# SPDX-License-Identifier: Apache-2.0

cmake_minimum_required(VERSION 3.13.1)

find_package(Zephyr HINTS $ENV{ZEPHYR_BASE})
project(external_rtc)

target_sources(app PRIVATE src/main.c)
```

## prj.conf
```kconfig
CONFIG_GPIO=y

# Newlibc
CONFIG_NEWLIB_LIBC=y

# POSIX API
CONFIG_POSIX_THREADS=y

# Log
CONFIG_LOG=y
CONFIG_LOG_MODE_IMMEDIATE=y

# Network
CONFIG_NETWORKING=y
CONFIG_NET_NATIVE=n
CONFIG_NET_SOCKETS=y
CONFIG_NET_SOCKETS_OFFLOAD=y

# LTE link control
CONFIG_LTE_LINK_CONTROL=y
CONFIG_LTE_NETWORK_MODE_LTE_M_GPS=y

# Modem library
CONFIG_NRF_MODEM_LIB=y

# Date Time library
CONFIG_DATE_TIME=y

# Adding Peripherals
CONFIG_I2C=y

# RTC
CONFIG_COUNTER=y
CONFIG_PCF85063A=y
```

## boards/circuitdojo_feather_nrf9160_ns.overlay
```dts
&i2c1 {
	zephyr,concat-buf-size = <256>;
};
```

## src/main.c
```c
/*
 * Copyright (c) 2020 Circuit Dojo LLC
 *
 * SPDX-License-Identifier: Apache-2.0
 */

#include <zephyr/kernel.h>
#include <zephyr/device.h>
#include <zephyr/drivers/gpio.h>
#include <zephyr/sys/util.h>
#include <zephyr/sys/printk.h>
#include <zephyr/drivers/counter.h>

#include <date_time.h>
#include <modem/lte_lc.h>
#include <modem/nrf_modem_lib.h>
#include <drivers/counter/pcf85063a.h>

#include <zephyr/logging/log.h>
LOG_MODULE_REGISTER(main);

K_SEM_DEFINE(date_time_ready, 0, 1);

/* RTC control */
static const struct device *rtc = DEVICE_DT_GET(DT_ALIAS(rtc0));

static void rtc_init()
{

	/* Check if ready*/
	if (!device_is_ready(rtc))
	{
		LOG_ERR("RTC is not ready!");
	}

	int err = counter_start(rtc);
	if (err)
	{
		LOG_ERR("Unable to start RTC. Err: %i", err);
	}
}

static void print_date_time(const struct tm *time)
{
	LOG_INF("%i:%i:%i %i/%i/%i - %i", time->tm_hour, time->tm_min, time->tm_sec, time->tm_mon + 1, time->tm_mday, 1900 + time->tm_year, time->tm_isdst);
	LOG_INF("yday %i", time->tm_yday);
}

static void date_time_event_handler(const struct date_time_evt *evt)
{
	switch (evt->type)
	{
	case DATE_TIME_OBTAINED_MODEM:
	case DATE_TIME_OBTAINED_NTP:
	case DATE_TIME_OBTAINED_EXT:
		LOG_INF("Date & time obtained.");
		k_sem_give(&date_time_ready);
		break;
	case DATE_TIME_NOT_OBTAINED:
		LOG_INF("Date & time not obtained.");
		break;
	default:
		break;
	}
}

int main(void)
{
	int err = 0;

	/* Init RTC */
	rtc_init();

	/* Init lte_lc*/
	err = lte_lc_init_and_connect();
	if (err)
		LOG_ERR("Failed to init and connect. Err: %i", err);

	/* Force time update */
	err = date_time_update_async(date_time_event_handler);
	if (err)
		LOG_ERR("Unable to update time with date_time_update_async. Err: %i", err);

	/* Wait for time */
	k_sem_take(&date_time_ready, K_FOREVER);

	/* Get the time */
	uint64_t ts = 0;
	err = date_time_now(&ts);
	if (err)
	{
		LOG_ERR("Unable to get date & time. Err: %i", err);
		return err;
	}

	/* Convert to seconds */
	ts = ts / 1000;

	LOG_INF("UTC Unix Epoc: %lld", ts);

	/* Convert time to struct tm */
	struct tm *tm_p = gmtime(&ts);
	struct tm time = {0};
	struct tm future_time = {0};

	if (tm_p != NULL)
	{
		memcpy(&time, tm_p, sizeof(struct tm));
	}
	else
	{
		LOG_ERR("Unable to convert to broken down UTC");
		return -EINVAL;
	}

	/* Print out the current time */
	print_date_time(&time);

	/* Set time */
	err = pcf85063a_set_time(rtc, &time);
	if (err)
	{
		LOG_ERR("Unable to set time. Err: %i", err);
		return err;
	}

	k_sleep(K_SECONDS(2));

	/* Get current time from device */
	err = pcf85063a_get_time(rtc, &future_time);
	if (err)
	{
		LOG_ERR("Unable to get time. Err: %i", err);
	}

	/* Print out the current time */
	print_date_time(&future_time);

	/* Convert back to timestamp */
	uint64_t future_ts = mktime(&future_time);

	LOG_INF("UTC Unix Epoc: %lld", future_ts);

	return 0;
}
```
