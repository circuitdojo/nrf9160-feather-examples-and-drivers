## CMakeLists.txt
```
# SPDX-License-Identifier: Apache-2.0

cmake_minimum_required(VERSION 3.20.0)
find_package(Zephyr REQUIRED HINTS $ENV{ZEPHYR_BASE})
project(https)

target_sources(app PRIVATE src/main.c)
target_sources(app PRIVATE src/cloud/cloud.c)
```

## Kconfig
```
mainmenu "Application Configuration"

config DEFAULT_DELAY
    int "Update interval (minutes)"
    default 1440

rsource "src/cloud/Kconfig"
source "Kconfig.zephyr"
```

## prj.conf
```kconfig
# Heap and stacks
CONFIG_HEAP_MEM_POOL_SIZE=8192
CONFIG_MAIN_STACK_SIZE=4096
CONFIG_SYSTEM_WORKQUEUE_STACK_SIZE=2048

# Network
CONFIG_NETWORKING=y
CONFIG_NET_NATIVE=n
CONFIG_NET_SOCKETS=y
CONFIG_NET_SOCKETS_OFFLOAD=y
CONFIG_POSIX_API=y
CONFIG_NET_IPV6=n
CONFIG_NET_IPV4=y

# LTE link control
CONFIG_LTE_LINK_CONTROL=y
CONFIG_LTE_NETWORK_MODE_LTE_M_GPS=y

# PSM enable
CONFIG_LTE_LC_PSM_MODULE=y
CONFIG_LTE_PSM_REQ=y
CONFIG_LTE_PSM_REQ_RPTAU="00100110" # 6 hour
CONFIG_LTE_PSM_REQ_RAT="00000011" # 6 sec active time

# Modem library
CONFIG_NRF_MODEM_LIB=y
CONFIG_NRF_MODEM_LIB_TRACE=n
CONFIG_MODEM_KEY_MGMT=y

# Date Time library
CONFIG_DATE_TIME=y

# Logging
CONFIG_LOG=y
# CONFIG_LOG_MODE_IMMEDIATE=y

# cJSON
CONFIG_CJSON_LIB=y

# HTTP
CONFIG_HTTP_CLIENT=y

# Debug
# CONFIG_ASSERT=y
# CONFIG_RESET_ON_FATAL_ERROR=n

# Change host
CONFIG_CLOUD_HOSTNAME="yourhostname.com"
CONFIG_CLOUD_PUBLISH_PATH="/api/v1/yourpath"
```

## boards/circuitdojo_feather_nrf9160_ns.conf
```kconfig
# Enable bootloader
CONFIG_BOOTLOADER_MCUBOOT=y
```

## src/main.c
```c
/*
 * Copyright (c) 2020 Circuit Dojo LLC
 *
 * SPDX-License-Identifier: Apache-2.0
 */

#include <zephyr/kernel.h>
#include <zephyr/pm/device.h>
#include <zephyr/logging/log.h>
LOG_MODULE_REGISTER(main);

/* nRF Libraries */
#include <modem/nrf_modem_lib.h>
#include <modem/lte_lc.h>
#include <modem/modem_info.h>

/* Local */
#include "cloud/cloud.h"

/* Timer */
static void timeout_handler(struct k_timer *timer_id);
K_TIMER_DEFINE(timer, timeout_handler, NULL);

/* Thread control */
K_SEM_DEFINE(thread_sem, 0, 1);

/* Variables */
static struct device_data data = {
    .do_something = true,
};

void cloud_cb(struct device_data *p_data)
{
    LOG_INF("Cloud callback");

    /* TODO: handle data here */
}

static void timeout_handler(struct k_timer *timer_id)
{
    LOG_INF("Timeout");
    k_sem_give(&thread_sem);
}

int main(void)
{
    int err;

    LOG_INF("HTTPS Sample. Board: %s", CONFIG_BOARD);

    /* Init modem lib */
    err = nrf_modem_lib_init();
    if (err < 0)
    {
        LOG_ERR("Failed to init modem lib. (err: %i)", err);
        return err;
    }

    /* Cloud init */
    err = cloud_init(cloud_cb);
    if (err < 0)
    {
        LOG_ERR("Unable to set callback. Err: %i", err);
        return err;
    }

    /* Power saving is turned on */
    lte_lc_psm_req(true);

    /* Connect */
    err = lte_lc_connect();
    if (err < 0)
    {
        LOG_ERR("Failed to connect. Err: %i", err);
        return err;
    }

    /* Start timer */
    k_timer_start(&timer, K_MINUTES(CONFIG_DEFAULT_DELAY), K_MINUTES(CONFIG_DEFAULT_DELAY));

    /* Allow for instant publish */
    k_sem_give(&thread_sem);

    while (1)
    {
        k_sem_take(&thread_sem, K_FOREVER);

        /* Publish and sleep .. */
        err = cloud_publish(&data);
        if (err < 0)
            LOG_ERR("Unable to publish. Err: %i", err);
    }
}
```
