## CMakeLists.txt
```
#
# Copyright (c) 2018 Nordic Semiconductor
#
# SPDX-License-Identifier: LicenseRef-Nordic-5-Clause
#

cmake_minimum_required(VERSION 3.13.1)



find_package(Zephyr REQUIRED HINTS $ENV{ZEPHYR_BASE})
project(NONE)

# NORDIC SDK APP START
target_sources(app PRIVATE ${NRF_DIR}/samples/cellular/at_client/src/main.c src/startup.c)
# NORDIC SDK APP END
```

## sample.yaml
```
sample:
  name: at_client Sample
tests:
  samples.cellular.at_client:
    sysbuild: true
    build_only: true
    platform_allow:
      - circuitdojo_feather_nrf9151/nrf9151/ns
    integration_platforms:
      - circuitdojo_feather_nrf9151/nrf9151/ns
    tags: ci_build
```

## prj.conf
```kconfig
#
# Copyright (c) 2019 Nordic Semiconductor ASA
#
# SPDX-License-Identifier: LicenseRef-Nordic-5-Clause
#
#
# Copyright (c) 2019 Nordic Semiconductor ASA
#
# SPDX-License-Identifier: LicenseRef-Nordic-5-Clause
#
# General config
CONFIG_ASSERT=y

# Network
CONFIG_NETWORKING=y
CONFIG_NET_NATIVE=n
CONFIG_NET_SOCKETS=y
CONFIG_NET_SOCKETS_OFFLOAD=y

# Modem library
CONFIG_NRF_MODEM_LIB=y

# AT host library
CONFIG_AT_HOST_LIBRARY=y
CONFIG_UART_INTERRUPT_DRIVEN=y

# Stacks and heaps
CONFIG_MAIN_STACK_SIZE=3072
CONFIG_HEAP_MEM_POOL_SIZE=16384
CONFIG_AT_MONITOR_HEAP_SIZE=512

# Trace
CONFIG_UART_ASYNC_API=y
CONFIG_NRF_MODEM_LIB_TRACE=y
CONFIG_NRF_MODEM_LIB_TRACE_BACKEND_UART=y
```

## boards/circuitdojo_feather_nrf9151_ns.conf
```kconfig
# Multithread
CONFIG_MULTITHREADING=y

# SPI
CONFIG_SPI=y
CONFIG_FLASH=y
CONFIG_SPI_NOR=y

# PMIC 
CONFIG_MFD=y
CONFIG_MFD_NPM13XX=y

# GPS Antenna configuration
CONFIG_MODEM_ANTENNA=y
CONFIG_MODEM_ANTENNA_AT_COEX0="AT\%XCOEX0=1,1,1565,1586"
```

## boards/circuitdojo_feather_nrf9161_ns.conf
```kconfig
# Multithread
CONFIG_MULTITHREADING=y

# SPI
CONFIG_SPI=y
CONFIG_SPI_NOR=y

# PMIC 
CONFIG_MFD=y
CONFIG_MFD_NPM13XX=y

# GPS Antenna configuration
CONFIG_MODEM_ANTENNA=y
CONFIG_MODEM_ANTENNA_AT_COEX0="AT\%XCOEX0=1,1,1565,1586"
```

## boards/circuitdojo_feather_nrf9151_ns.overlay
```dts
&uart1 {
	status = "okay";
	current-speed = <1000000>;
};
```

## boards/circuitdojo_feather_nrf9160_ns.overlay
```dts
/*
* Copyright (c) 2020 Circuit Dojo LLC
*
* SPDX-License-Identifier: Apache-2.0
*/

&uart1 {
    status = "okay";
    current-speed = <115200>;
    tx-pin = <24>;
    rx-pin = <23>;
    };
```

## src/startup.c
```c
#include <zephyr/kernel.h>
#include <zephyr/drivers/gpio.h>
#include <zephyr/logging/log.h>
LOG_MODULE_REGISTER(startup);

#include <modem/nrf_modem_lib.h>
#include <nrf_modem_at.h>

/* Initialization of AUX pin */
#if defined(CONFIG_BOARD_CIRCUITDOJO_FEATHER_NRF9151)
#define AUXANTCFG_ENABLE "AT\%XANTCFG=1"

NRF_MODEM_LIB_ON_INIT(aux_init_hook, on_modem_lib_init, NULL);

static void on_modem_lib_init(int ret, void *ctx)
{
    ARG_UNUSED(ctx);

    if (ret != 0)
    {
        return;
    }

    printk("*** Setting configuration: %s ***\n", AUXANTCFG_ENABLE);
    int err = nrf_modem_at_printf("%s", AUXANTCFG_ENABLE);
    if (err)
    {
        LOG_ERR("Failed to set configuration (err: %d)", err);
    }
}
#endif
```
